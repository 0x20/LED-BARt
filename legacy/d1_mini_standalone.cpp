// M. Wyns 2017
// Ported to ESP8266 2025

#include <Arduino.h>
//#include <TimerOne.h>
#include <TimeLib.h>
//#include "Wire.h"  // I2C bibliotheek
//#define TMP102_I2C_ADDRESS 72 // I2C address, ADD0 verbonden met GND

int teller =0;
float tempC = 0;

// Forward declarations
float getTemp();

// ESP8266 D1 Mini Pin Mapping
// D0 = GPIO16 (wake from deep sleep, no PWM/I2C)
// D1 = GPIO5 (SCL - I2C clock)
// D2 = GPIO4 (SDA - I2C data)
// D3 = GPIO0 (FLASH button, pulled up, boot fails if pulled low)
// D4 = GPIO2 (built-in LED, pulled up, boot fails if pulled low)
// D5 = GPIO14 (SCLK)
// D6 = GPIO12 (MISO)
// D7 = GPIO13 (MOSI)
// D8 = GPIO15 (pulled to GND, boot fails if pulled high)

#define KLOK D5  // GPIO14 - lichtkrant clock
#define DATA D6  // GPIO12 - lichtkrant data

// Row pins - 7 pins needed for the display rows
// Using D0, D1, D2, D3, D4, D7, D8
byte pinRij[7] = {D0, D1, D2, D3, D4, D7, D8};  // GPIO16, GPIO5, GPIO4, GPIO0, GPIO2, GPIO13, GPIO15

#define pulstijd 1500

unsigned char tekst[] = {'1','0',':','0','9',' ','2','4','/','0','5',' ',' ','1','6','.','5',126,'C'};

static unsigned char Font5x7[] = {
  0x00, 0x00, 0x00, 0x00, 0x00,// (space) 32
  0x00, 0x00, 0x5F, 0x00, 0x00,// ! 33
  0x00, 0x07, 0x00, 0x07, 0x00,// "
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  0x00, 0x07, 0x05, 0x07, 0x00 // °  126
};


void setup() {
  setTime(1496399575);
  pinMode(KLOK, OUTPUT);
  pinMode(DATA, OUTPUT);
  for (int i =0; i <=6; i++) pinMode(pinRij[i],OUTPUT);
//  Timer1.initialize(500000);
//  Timer1.attachInterrupt( timerIsr );
//  Wire.begin();   // I2C initialiseren
  Serial.begin(115200);  // ESP8266 typically uses 115200 baud
}

void loop() {
 for (int rij = 0; rij <= 6; rij++) {
   for (int kar = 0; kar <= 18; kar++) {
     for (int kolom = 0; kolom <= 4; kolom++) {
       if (bitRead((Font5x7[(tekst[kar]-32)*5+kolom]),rij)) {
         digitalWrite(KLOK, HIGH);
         digitalWrite(DATA, HIGH);
         digitalWrite(KLOK, LOW);
         digitalWrite(DATA, HIGH);
       }
       else {
         digitalWrite(KLOK, HIGH);
         digitalWrite(DATA, LOW);
         digitalWrite(KLOK, LOW);
         digitalWrite(DATA, LOW);
       }
      }
    }
    digitalWrite(KLOK, HIGH);
    digitalWrite(KLOK, LOW);

    digitalWrite(pinRij[rij], HIGH);
    delayMicroseconds(pulstijd);
    digitalWrite(pinRij[rij], LOW);
  }


  teller++;

  if (teller % 40 == 0) {     // +/- 0.5 s
    if (tekst[2] == ':') tekst[2] = ' ';
    else tekst[2] = ':';
  }

  if (teller % 800 == 0) {    // +/- 10 s
    tekst[0] = hour() / 10 + 0x30;
    tekst[1] = hour() % 10 + 0x30;
    tekst[3] = minute() / 10 + 0x30;
    tekst[4] = minute() % 10 + 0x30;
    tekst[6] = day() / 10 + 0x30;
    tekst[7] = day() % 10 + 0x30;
    tekst[9] = month() / 10 + 0x30;
    tekst[10] = month() % 10 + 0x30;

    tempC = getTemp();
    Serial.println(tempC);
    tekst[13] = tempC / 10 + 0x30;
    tekst[14] = (int)(tempC) % 10 + 0x30;
    tekst[16] = (int)(tempC * 10) % 10 + 0x30;
    teller = 0;
  }
}


float getTemp(){
  return 26;

//  Wire.begin();  // ESP8266 I2C: SDA=D2(GPIO4), SCL=D1(GPIO5) by default
//  Wire.beginTransmission(TMP102_I2C_ADDRESS);
//  Wire.write(0x00);    // pointer register
//  Wire.endTransmission();
//  Wire.requestFrom(TMP102_I2C_ADDRESS, 2); // 2 bytes opvragen
//  Wire.endTransmission();
//  byte MSB = Wire.read();
//  byte LSB = Wire.read();
//  int waarde = ((MSB) << 4);
//  waarde |= (LSB >> 4);
//  float temperatuur = waarde*0.0625;
//  return temperatuur;
}
